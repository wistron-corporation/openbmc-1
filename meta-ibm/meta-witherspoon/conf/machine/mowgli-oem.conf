## meta-ibm/meta-witherspoon/conf/machine/mowgli-oem.conf
```bitbake
CHINEOVERRIDES =. "mowgli:"
require conf/machine/mowgli.conf

KERNEL_DEVICETREE = "${KMACHINE}-bmc-opp-${MACHINE}.dtb"

MRW_XML = "mowgli.xml"
```
